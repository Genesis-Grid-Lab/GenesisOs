## configs/genesisos_defconfig
```kconfig
BR2_x86_64=y
#BR2_TOOLCHAIN_BUILDROOT_MUSL=y
BR2_TOOLCHAIN_EXTERNAL=y
BR2_TOOLCHAIN_EXTERNAL_BOOTLIN_X86_64_GLIBC_LATEST=y
BR2_SYSTEM_DHCP="eth0"

# Graphics
BR2_PACKAGE_MESA3D=y
BR2_PACKAGE_MESA3D_GIT=y
BR2_PACKAGE_MESA3D_GBM=y
BR2_PACKAGE_MESA3D_DRI_DRIVER_AUTO=n
BR2_PACKAGE_MESA3D_DRI_DRIVER_VIRGL=y
BR2_PACKAGE_MESA3D_VULKAN_DRIVER_INTEL=y
BR2_PACKAGE_MESA3D_VULKAN_DRIVER_RADEON=y
BR2_PACKAGE_MESA3D_OPENGL_EGL=y
BR2_PACKAGE_MESA3D_OPENGL_ES=y
BR2_PACKAGE_PROVIDES_LIBGBM="mesa3d"
BR2_PACKAGE_PROVIDES_LIBEGL="mesa3d"
BR2_PACKAGE_PROVIDES_LIBGLES="mesa3d"
BR2_PACKAGE_MESA3D_GALLIUM_DRIVER="crocus softpipe"
BR@_PACKAGE_HOST_QEMU_SYSTEM_MODE=y
BR2_PACKAGE_LIBDRM=y
BR2_PACKAGE_LIBEGL=y
BR2_PACKAGE_LIBGBM=y
BR2_PACKAGE_LIBDRM_INTEL=y
BR2_PACKAGE_LIBDRM_RADEON=y
BR2_PACKAGE_KMSXX=y
BR2_PACKAGE_VULKAN_HEADERS=y
BR2_PACKAGE_VULKAN_LOADER=y
BR2_PACKAGE_MESA3D_GALLIUM=y
BR2_PACKAGE_MESA3D_GALLIUM_DRIVER=y
BR2_PACKAGE_MESA3D_DRI_DRIVER_INSTALL_ALL=y
#BR2_PACKAGE_MESA3D_DRI_DRIVER_I915=y
BR2_PACKAGE_MESA3D_GALLIUM_DRIVER_INTEL=y
BR2_PACKAGE_MESA3D_GALLIUM_DRIVER_I915=y
#BR2_PACKAGE_MESA3D_DRI_DRIVER_SWRAST=y
BR2_PACKAGE_MESA3D_GALLIUM_DRIVER_VIRGL=y
BR2_PACKAGE_MESA3D_GALLIUM_DRIVER_SOFTPIPE=y
BR2_PACKAGE_MESA3D_GALLIUM_DRIVER_R600=y
BR2_PACKAGE_MESA3D_GALLIUM_DRIVER_CROCUS=y
BR2_PACKAGE_GLES2=y
BR2_PACKAGE_GLM=y
BR2_PACKAGE_MOUNT=y

# Input + SDL2 (or GLFW)
BR2_PACKAGE_LIBINPUT=y
BR2_PACKAGE_EVDEV=y
BR2_PACKAGE_SDL2=y
BR2_PACKAGE_SDL2_KMSDRM=y
BR2_PACKAGE_SDL2_OPENGLES=y
BR2_PACKAGE_EUDEV=y
BR2_PACKAGE_PROVIDES_UDEV="eudev"
BR2_PACKAGE_EUDEV_MODULE_LOADING=y
BR@_PACKAGE_EUDEV_ENABLE_HWDB=y
BR2_ROOTFS_DEVICE_CREATION_DYNAMIC_EUDEV=y

# Your custom UI engine
BR2_PACKAGE_GENESIS_OS=y

# Boot to your app
BR2_ROOTFS_OVERLAY="$(BR2_EXTERNAL_GenesisOS_PATH)/overlay"
BR2_ROOTFS_POST_BUILD_SCRIPT="$(BR2_EXTERNAL_GenesisOS_PATH)/post-build.sh"
BR2_ROOTFS_POST_IMAGE_SCRIPT="$(BR2_EXTERNAL_GenesisOS_PATH)/post-image.sh"
#BR2_INIT_NONE=y
BR2_INIT_BUSYBOX=y
BR2_TARGET_GENERIC_GETTY_PORT="tty1"
BR2_TARGET_ROOTFS_EXT2=n
BR2_TARGET_ROOTFS_EXT2_4=y
BR2_TARGET_ROOTFS_EXT2_SIZE="512M"
BR2_TARGET_ROOTFS_EXT2_LABEL="GENESISOS"

BR2_TARGET_GENERIC_HOSTNAME="GenesisOS"
BR2_TARGET_GENERIC_ISSUE="Welcome to GenesisOS"

BR2_TARGET_ROOTFS_CPIO=y
BR2_TARGET_ROOTFS_CPIO_GZIP=y

BR2_LINUX_KERNEL_USE_CUSTOM_CONFIG=y
#BR2_LINUX_KERNEL_CUSTOM_CONFIG_FILE="configs/linux.config"
BR2_LINUX_KERNEL_CUSTOM_CONFIG_FILE="$(BR2_EXTERNAL_GenesisOS_PATH)/kernel.config"

# Kernel
BR2_LINUX_KERNEL=y
#BR2_LINUX_KERNEL_USE_DEFCONFIG=y
#BR2_LINUX_KERNEL_DEFCONFIG="x86_64"
BR2_LINUX_KERNEL_CUSTOM_VERSION=y
BR2_LINUX_KERNEL_CUSTOM_VERSION_VALUE="6.9"
#BR2_LINUX_KERNEL_VMLINUX=y
BR2_LINUX_KERNEL_IMAGE=y
BR2_LINUX_KERNEL_INSTALL_TARGET=y
BR2_LINUX_KERNEL_NEEDS_HOST_OPENSSL=y
BR2_LINUX_KERNEL_BINARY_FORMAT="bzImage"
#BR2_LINUX_KERNEL_IMAGE_TARGET_CUSTOM=y
#BR2_LINUX_KERNEL_IMAGE_TARGET_NAME="bzImage"

# This value embeds initramfs
BR2_LINUX_KERNEL_INITRAMFS_SOURCE="output/images/rootfs.cpio.gz"
```

## external/Config.in
```kconfig
menu "GenesisOS Custom Packages"

source "$BR2_EXTERNAL_GenesisOS_PATH/package/genesis-os/Config.in"

endmenu
```

## external/package/genesis-os/Config.in
```kconfig
config BR2_PACKAGE_GENESIS_OS
    bool "Genesis OS"
    depends on BR2_PACKAGE_MESA3D_OPENGL_EGL
    select BR2_PACKAGE_LIBDRM
    select BR2_PACKAGE_LIBEGL
    select BR2_PACKAGE_LIBGBM
    select BR2_PACKAGE_GLES2
    help
      A custom 3D UI/game interface for GenesisOS
```

## external/package/genesis-ui/Config.in
```kconfig
config BR2_PACKAGE_GENESIS_UI
    bool "Genesis UI"
    depends on BR2_PACKAGE_MESA3D_OPENGL_EGL
    #depends on BR2_PACKAGE_LIBGL
    #depends on BR2_PACKAGE_HAS_LIBGL
    depends on BR2_PACKAGE_SDL2
    help
      A custom 3D UI/game interface for GenesisOS
```
